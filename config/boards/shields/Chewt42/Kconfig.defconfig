## config/boards/shields/Chewt42/Kconfig.defconfig
```kconfig
if SHIELD_CHEWT32_LEFT

config ZMK_KEYBOARD_NAME
    default "Chewt32"

config ZMK_SPLIT_BLE_ROLE_CENTRAL
    default y

endif

if SHIELD_CHEWT32_LEFT || SHIELD_CHEWT32_RIGHT

config ZMK_SPLIT
    default y

endif
```

## config/boards/shields/Chewt42/Kconfig.shield
```kconfig
config SHIELD_CHEWT32_LEFT
    def_bool $(shields_list_contains,chewt32_left)

config SHIELD_CHEWT32_RIGHT
    def_bool $(shields_list_contains,chewt32_right)
```
